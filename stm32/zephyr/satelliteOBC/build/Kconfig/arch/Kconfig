## stm32/zephyr/satelliteOBC/build/Kconfig/soc/Kconfig.sysbuild
```kconfig
# Load Sysbuild SoC Kconfig descriptions.
osource "/gsFiles/Projects/stm32/zephyr/satelliteOBC/zephyr/soc/xlnx/zynqmp/Kconfig.sysbuild"
osource "/gsFiles/Projects/stm32/zephyr/satelliteOBC/zephyr/soc/xlnx/zynq7000/Kconfig.sysbuild"
osource "/gsFiles/Projects/stm32/zephyr/satelliteOBC/zephyr/soc/xlnx/versalnet/Kconfig.sysbuild"
osource "/gsFiles/Projects/stm32/zephyr/satelliteOBC/zephyr/soc/xlnx/versal2/Kconfig.sysbuild"
osource "/gsFiles/Projects/stm32/zephyr/satelliteOBC/zephyr/soc/xlnx/versal/Kconfig.sysbuild"
osource "/gsFiles/Projects/stm32/zephyr/satelliteOBC/zephyr/soc/xen/Kconfig.sysbuild"
osource "/gsFiles/Projects/stm32/zephyr/satelliteOBC/zephyr/soc/wch/ch32v/Kconfig.sysbuild"
osource "/gsFiles/Projects/stm32/zephyr/satelliteOBC/zephyr/soc/ti/simplelink/Kconfig.sysbuild"
osource "/gsFiles/Projects/stm32/zephyr/satelliteOBC/zephyr/soc/ti/mspm0/Kconfig.sysbuild"
osource "/gsFiles/Projects/stm32/zephyr/satelliteOBC/zephyr/soc/ti/lm3s6965/Kconfig.sysbuild"
osource "/gsFiles/Projects/stm32/zephyr/satelliteOBC/zephyr/soc/ti/k3/Kconfig.sysbuild"
osource "/gsFiles/Projects/stm32/zephyr/satelliteOBC/zephyr/soc/telink/tlsr/Kconfig.sysbuild"
osource "/gsFiles/Projects/stm32/zephyr/satelliteOBC/zephyr/soc/syna/sr100/Kconfig.sysbuild"
osource "/gsFiles/Projects/stm32/zephyr/satelliteOBC/zephyr/soc/starfive/jh71xx/Kconfig.sysbuild"
osource "/gsFiles/Projects/stm32/zephyr/satelliteOBC/zephyr/soc/st/stm32/Kconfig.sysbuild"
osource "/gsFiles/Projects/stm32/zephyr/satelliteOBC/zephyr/soc/snps/qemu_arc/Kconfig.sysbuild"
osource "/gsFiles/Projects/stm32/zephyr/satelliteOBC/zephyr/soc/snps/nsim/arc_v/Kconfig.sysbuild"
osource "/gsFiles/Projects/stm32/zephyr/satelliteOBC/zephyr/soc/snps/nsim/arc_classic/Kconfig.sysbuild"
osource "/gsFiles/Projects/stm32/zephyr/satelliteOBC/zephyr/soc/snps/hsdk4xd/Kconfig.sysbuild"
osource "/gsFiles/Projects/stm32/zephyr/satelliteOBC/zephyr/soc/snps/hsdk/Kconfig.sysbuild"
osource "/gsFiles/Projects/stm32/zephyr/satelliteOBC/zephyr/soc/snps/emsk/Kconfig.sysbuild"
osource "/gsFiles/Projects/stm32/zephyr/satelliteOBC/zephyr/soc/snps/emsdp/Kconfig.sysbuild"
osource "/gsFiles/Projects/stm32/zephyr/satelliteOBC/zephyr/soc/snps/arc_iot/Kconfig.sysbuild"
osource "/gsFiles/Projects/stm32/zephyr/satelliteOBC/zephyr/soc/silabs/Kconfig.sysbuild"
osource "/gsFiles/Projects/stm32/zephyr/satelliteOBC/zephyr/soc/sifli/sf32/Kconfig.sysbuild"
osource "/gsFiles/Projects/stm32/zephyr/satelliteOBC/zephyr/soc/sifive/sifive_freedom/Kconfig.sysbuild"
osource "/gsFiles/Projects/stm32/zephyr/satelliteOBC/zephyr/soc/sensry/Kconfig.sysbuild"
osource "/gsFiles/Projects/stm32/zephyr/satelliteOBC/zephyr/soc/rockchip/Kconfig.sysbuild"
osource "/gsFiles/Projects/stm32/zephyr/satelliteOBC/zephyr/soc/renode/riscv_virtual/Kconfig.sysbuild"
osource "/gsFiles/Projects/stm32/zephyr/satelliteOBC/zephyr/soc/renode/cortex_r8_virtual/Kconfig.sysbuild"
osource "/gsFiles/Projects/stm32/zephyr/satelliteOBC/zephyr/soc/renesas/smartbond/Kconfig.sysbuild"
osource "/gsFiles/Projects/stm32/zephyr/satelliteOBC/zephyr/soc/renesas/rz/Kconfig.sysbuild"
osource "/gsFiles/Projects/stm32/zephyr/satelliteOBC/zephyr/soc/renesas/rx/Kconfig.sysbuild"
osource "/gsFiles/Projects/stm32/zephyr/satelliteOBC/zephyr/soc/renesas/rcar/Kconfig.sysbuild"
osource "/gsFiles/Projects/stm32/zephyr/satelliteOBC/zephyr/soc/renesas/ra/Kconfig.sysbuild"
osource "/gsFiles/Projects/stm32/zephyr/satelliteOBC/zephyr/soc/realtek/fingerprint/Kconfig.sysbuild"
osource "/gsFiles/Projects/stm32/zephyr/satelliteOBC/zephyr/soc/realtek/ec/Kconfig.sysbuild"
osource "/gsFiles/Projects/stm32/zephyr/satelliteOBC/zephyr/soc/realtek/bee/Kconfig.sysbuild"
osource "/gsFiles/Projects/stm32/zephyr/satelliteOBC/zephyr/soc/realtek/ameba/Kconfig.sysbuild"
osource "/gsFiles/Projects/stm32/zephyr/satelliteOBC/zephyr/soc/raspberrypi/rpi_pico/Kconfig.sysbuild"
osource "/gsFiles/Projects/stm32/zephyr/satelliteOBC/zephyr/soc/quicklogic/eos_s3/Kconfig.sysbuild"
osource "/gsFiles/Projects/stm32/zephyr/satelliteOBC/zephyr/soc/qemu/virt_riscv/Kconfig.sysbuild"
osource "/gsFiles/Projects/stm32/zephyr/satelliteOBC/zephyr/soc/qemu/or1k/Kconfig.sysbuild"
osource "/gsFiles/Projects/stm32/zephyr/satelliteOBC/zephyr/soc/qemu/malta/Kconfig.sysbuild"
osource "/gsFiles/Projects/stm32/zephyr/satelliteOBC/zephyr/soc/openisa/rv32m1/Kconfig.sysbuild"
osource "/gsFiles/Projects/stm32/zephyr/satelliteOBC/zephyr/soc/openhwgroup/cva6/Kconfig.sysbuild"
osource "/gsFiles/Projects/stm32/zephyr/satelliteOBC/zephyr/soc/oct/osd32mp15x/Kconfig.sysbuild"
osource "/gsFiles/Projects/stm32/zephyr/satelliteOBC/zephyr/soc/nxp/s32/Kconfig.sysbuild"
osource "/gsFiles/Projects/stm32/zephyr/satelliteOBC/zephyr/soc/nxp/rw/Kconfig.sysbuild"
osource "/gsFiles/Projects/stm32/zephyr/satelliteOBC/zephyr/soc/nxp/mcx/Kconfig.sysbuild"
osource "/gsFiles/Projects/stm32/zephyr/satelliteOBC/zephyr/soc/nxp/lpc/Kconfig.sysbuild"
osource "/gsFiles/Projects/stm32/zephyr/satelliteOBC/zephyr/soc/nxp/layerscape/Kconfig.sysbuild"
osource "/gsFiles/Projects/stm32/zephyr/satelliteOBC/zephyr/soc/nxp/kinetis/Kconfig.sysbuild"
osource "/gsFiles/Projects/stm32/zephyr/satelliteOBC/zephyr/soc/nxp/imxrt/Kconfig.sysbuild"
osource "/gsFiles/Projects/stm32/zephyr/satelliteOBC/zephyr/soc/nxp/imx/Kconfig.sysbuild"
osource "/gsFiles/Projects/stm32/zephyr/satelliteOBC/zephyr/soc/nuvoton/numicro/Kconfig.sysbuild"
osource "/gsFiles/Projects/stm32/zephyr/satelliteOBC/zephyr/soc/nuvoton/numaker/Kconfig.sysbuild"
osource "/gsFiles/Projects/stm32/zephyr/satelliteOBC/zephyr/soc/nuvoton/npcx/Kconfig.sysbuild"
osource "/gsFiles/Projects/stm32/zephyr/satelliteOBC/zephyr/soc/nuvoton/npcm/Kconfig.sysbuild"
osource "/gsFiles/Projects/stm32/zephyr/satelliteOBC/zephyr/soc/nordic/Kconfig.sysbuild"
osource "/gsFiles/Projects/stm32/zephyr/satelliteOBC/zephyr/soc/neorv32/Kconfig.sysbuild"
osource "/gsFiles/Projects/stm32/zephyr/satelliteOBC/zephyr/soc/native/inf_clock/Kconfig.sysbuild"
osource "/gsFiles/Projects/stm32/zephyr/satelliteOBC/zephyr/soc/microchip/sam/sama7/Kconfig.sysbuild"
osource "/gsFiles/Projects/stm32/zephyr/satelliteOBC/zephyr/soc/microchip/sam/sam_d5x_e5x/Kconfig.sysbuild"
osource "/gsFiles/Projects/stm32/zephyr/satelliteOBC/zephyr/soc/microchip/pic64/Kconfig.sysbuild"
osource "/gsFiles/Projects/stm32/zephyr/satelliteOBC/zephyr/soc/microchip/pic32c/pic32cz_ca/Kconfig.sysbuild"
osource "/gsFiles/Projects/stm32/zephyr/satelliteOBC/zephyr/soc/microchip/pic32c/pic32cx_sg/Kconfig.sysbuild"
osource "/gsFiles/Projects/stm32/zephyr/satelliteOBC/zephyr/soc/microchip/pic32c/pic32cm_sg_gc/Kconfig.sysbuild"
osource "/gsFiles/Projects/stm32/zephyr/satelliteOBC/zephyr/soc/microchip/pic32c/pic32cm_pl/Kconfig.sysbuild"
osource "/gsFiles/Projects/stm32/zephyr/satelliteOBC/zephyr/soc/microchip/pic32c/pic32cm_jh/Kconfig.sysbuild"
osource "/gsFiles/Projects/stm32/zephyr/satelliteOBC/zephyr/soc/microchip/pic32c/pic32ck_sg_gc/Kconfig.sysbuild"
osource "/gsFiles/Projects/stm32/zephyr/satelliteOBC/zephyr/soc/microchip/miv/Kconfig.sysbuild"
osource "/gsFiles/Projects/stm32/zephyr/satelliteOBC/zephyr/soc/microchip/mec/Kconfig.sysbuild"
osource "/gsFiles/Projects/stm32/zephyr/satelliteOBC/zephyr/soc/mediatek/mt8xxx/Kconfig.sysbuild"
osource "/gsFiles/Projects/stm32/zephyr/satelliteOBC/zephyr/soc/lowrisc/opentitan/Kconfig.sysbuild"
osource "/gsFiles/Projects/stm32/zephyr/satelliteOBC/zephyr/soc/litex/Kconfig.sysbuild"
osource "/gsFiles/Projects/stm32/zephyr/satelliteOBC/zephyr/soc/ite/ec/Kconfig.sysbuild"
osource "/gsFiles/Projects/stm32/zephyr/satelliteOBC/zephyr/soc/intel/wildcat_lake/Kconfig.sysbuild"
osource "/gsFiles/Projects/stm32/zephyr/satelliteOBC/zephyr/soc/intel/raptor_lake/Kconfig.sysbuild"
osource "/gsFiles/Projects/stm32/zephyr/satelliteOBC/zephyr/soc/intel/panther_lake/Kconfig.sysbuild"
osource "/gsFiles/Projects/stm32/zephyr/satelliteOBC/zephyr/soc/intel/lakemont/Kconfig.sysbuild"
osource "/gsFiles/Projects/stm32/zephyr/satelliteOBC/zephyr/soc/intel/intel_socfpga_std/Kconfig.sysbuild"
osource "/gsFiles/Projects/stm32/zephyr/satelliteOBC/zephyr/soc/intel/intel_socfpga/Kconfig.sysbuild"
osource "/gsFiles/Projects/stm32/zephyr/satelliteOBC/zephyr/soc/intel/intel_niosv/Kconfig.sysbuild"
osource "/gsFiles/Projects/stm32/zephyr/satelliteOBC/zephyr/soc/intel/intel_ish/Kconfig.sysbuild"
osource "/gsFiles/Projects/stm32/zephyr/satelliteOBC/zephyr/soc/intel/intel_adsp/Kconfig.sysbuild"
osource "/gsFiles/Projects/stm32/zephyr/satelliteOBC/zephyr/soc/intel/elkhart_lake/Kconfig.sysbuild"
osource "/gsFiles/Projects/stm32/zephyr/satelliteOBC/zephyr/soc/intel/atom/Kconfig.sysbuild"
osource "/gsFiles/Projects/stm32/zephyr/satelliteOBC/zephyr/soc/intel/apollo_lake/Kconfig.sysbuild"
osource "/gsFiles/Projects/stm32/zephyr/satelliteOBC/zephyr/soc/intel/alder_lake/Kconfig.sysbuild"
osource "/gsFiles/Projects/stm32/zephyr/satelliteOBC/zephyr/soc/infineon/psoc4/Kconfig.sysbuild"
osource "/gsFiles/Projects/stm32/zephyr/satelliteOBC/zephyr/soc/infineon/edge/Kconfig.sysbuild"
osource "/gsFiles/Projects/stm32/zephyr/satelliteOBC/zephyr/soc/infineon/cat3/Kconfig.sysbuild"
osource "/gsFiles/Projects/stm32/zephyr/satelliteOBC/zephyr/soc/infineon/cat1c/Kconfig.sysbuild"
osource "/gsFiles/Projects/stm32/zephyr/satelliteOBC/zephyr/soc/infineon/cat1b/Kconfig.sysbuild"
osource "/gsFiles/Projects/stm32/zephyr/satelliteOBC/zephyr/soc/infineon/cat1a/Kconfig.sysbuild"
osource "/gsFiles/Projects/stm32/zephyr/satelliteOBC/zephyr/soc/gd/gd32/Kconfig.sysbuild"
osource "/gsFiles/Projects/stm32/zephyr/satelliteOBC/zephyr/soc/gaisler/leon3/Kconfig.sysbuild"
osource "/gsFiles/Projects/stm32/zephyr/satelliteOBC/zephyr/soc/gaisler/gr716a/Kconfig.sysbuild"
osource "/gsFiles/Projects/stm32/zephyr/satelliteOBC/zephyr/soc/focaltech/Kconfig.sysbuild"
osource "/gsFiles/Projects/stm32/zephyr/satelliteOBC/zephyr/soc/espressif/Kconfig.sysbuild"
osource "/gsFiles/Projects/stm32/zephyr/satelliteOBC/zephyr/soc/ene/kb1200/Kconfig.sysbuild"
osource "/gsFiles/Projects/stm32/zephyr/satelliteOBC/zephyr/soc/ene/kb106x/Kconfig.sysbuild"
osource "/gsFiles/Projects/stm32/zephyr/satelliteOBC/zephyr/soc/elan/em32f967/Kconfig.sysbuild"
osource "/gsFiles/Projects/stm32/zephyr/satelliteOBC/zephyr/soc/egis/Kconfig.sysbuild"
osource "/gsFiles/Projects/stm32/zephyr/satelliteOBC/zephyr/soc/efinix/sapphire/Kconfig.sysbuild"
osource "/gsFiles/Projects/stm32/zephyr/satelliteOBC/zephyr/soc/cdns/xtensa_sample_controller/Kconfig.sysbuild"
osource "/gsFiles/Projects/stm32/zephyr/satelliteOBC/zephyr/soc/cdns/swerv/Kconfig.sysbuild"
osource "/gsFiles/Projects/stm32/zephyr/satelliteOBC/zephyr/soc/cdns/sample_controller32/Kconfig.sysbuild"
osource "/gsFiles/Projects/stm32/zephyr/satelliteOBC/zephyr/soc/cdns/dc233c/Kconfig.sysbuild"
osource "/gsFiles/Projects/stm32/zephyr/satelliteOBC/zephyr/soc/brcm/bcmvk/Kconfig.sysbuild"
osource "/gsFiles/Projects/stm32/zephyr/satelliteOBC/zephyr/soc/brcm/bcm2712/Kconfig.sysbuild"
osource "/gsFiles/Projects/stm32/zephyr/satelliteOBC/zephyr/soc/brcm/bcm2711/Kconfig.sysbuild"
osource "/gsFiles/Projects/stm32/zephyr/satelliteOBC/zephyr/soc/blackberry/qnxhv_vm/Kconfig.sysbuild"
osource "/gsFiles/Projects/stm32/zephyr/satelliteOBC/zephyr/soc/bflb/Kconfig.sysbuild"
osource "/gsFiles/Projects/stm32/zephyr/satelliteOBC/zephyr/soc/atmel/sam0/Kconfig.sysbuild"
osource "/gsFiles/Projects/stm32/zephyr/satelliteOBC/zephyr/soc/atmel/sam/Kconfig.sysbuild"
osource "/gsFiles/Projects/stm32/zephyr/satelliteOBC/zephyr/soc/aspeed/Kconfig.sysbuild"
osource "/gsFiles/Projects/stm32/zephyr/satelliteOBC/zephyr/soc/arm/Kconfig.sysbuild"
osource "/gsFiles/Projects/stm32/zephyr/satelliteOBC/zephyr/soc/arm/beetle/Kconfig.sysbuild"
osource "/gsFiles/Projects/stm32/zephyr/satelliteOBC/zephyr/soc/antmicro/myra/Kconfig.sysbuild"
osource "/gsFiles/Projects/stm32/zephyr/satelliteOBC/zephyr/soc/andestech/Kconfig.sysbuild"
osource "/gsFiles/Projects/stm32/zephyr/satelliteOBC/zephyr/soc/amd/acp_7_0/Kconfig.sysbuild"
osource "/gsFiles/Projects/stm32/zephyr/satelliteOBC/zephyr/soc/amd/acp_6_0/Kconfig.sysbuild"
osource "/gsFiles/Projects/stm32/zephyr/satelliteOBC/zephyr/soc/ambiq/Kconfig.sysbuild"
osource "/gsFiles/Projects/stm32/zephyr/satelliteOBC/zephyr/soc/allwinner/sun8i_h3/Kconfig.sysbuild"
osource "/gsFiles/Projects/stm32/zephyr/satelliteOBC/zephyr/soc/allwinner/sun50i_h618/Kconfig.sysbuild"
osource "/gsFiles/Projects/stm32/zephyr/satelliteOBC/zephyr/soc/alif/ensemble/Kconfig.sysbuild"
osource "/gsFiles/Projects/stm32/zephyr/satelliteOBC/zephyr/soc/alif/balletto/Kconfig.sysbuild"
osource "/gsFiles/Projects/stm32/zephyr/satelliteOBC/zephyr/soc/aesc/Kconfig.sysbuild"
osource "/gsFiles/Projects/stm32/zephyr/satelliteOBC/zephyr/soc/adi/max32/Kconfig.sysbuild"
```
