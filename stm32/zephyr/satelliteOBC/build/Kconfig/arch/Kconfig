## stm32/zephyr/satelliteOBC/build/Kconfig/arch/Kconfig
```kconfig
# Load Zephyr Arch Kconfig descriptions.
osource "/gsFiles/Projects/stm32/zephyr/satelliteOBC/zephyr/arch/rx/Kconfig"
osource "/gsFiles/Projects/stm32/zephyr/satelliteOBC/zephyr/arch/x86/Kconfig"
osource "/gsFiles/Projects/stm32/zephyr/satelliteOBC/zephyr/arch/xtensa/Kconfig"
osource "/gsFiles/Projects/stm32/zephyr/satelliteOBC/zephyr/arch/sparc/Kconfig"
osource "/gsFiles/Projects/stm32/zephyr/satelliteOBC/zephyr/arch/riscv/Kconfig"
osource "/gsFiles/Projects/stm32/zephyr/satelliteOBC/zephyr/arch/posix/Kconfig"
osource "/gsFiles/Projects/stm32/zephyr/satelliteOBC/zephyr/arch/openrisc/Kconfig"
osource "/gsFiles/Projects/stm32/zephyr/satelliteOBC/zephyr/arch/mips/Kconfig"
osource "/gsFiles/Projects/stm32/zephyr/satelliteOBC/zephyr/arch/arm64/Kconfig"
osource "/gsFiles/Projects/stm32/zephyr/satelliteOBC/zephyr/arch/arm/Kconfig"
osource "/gsFiles/Projects/stm32/zephyr/satelliteOBC/zephyr/arch/arc/Kconfig"
```

## stm32/zephyr/satelliteOBC/build/Kconfig/boards/Kconfig.defconfig
```kconfig
# Load Zephyr board defconfig descriptions.
osource "/gsFiles/Projects/stm32/zephyr/satelliteOBC/zephyr/boards/st/nucleo_f303re/Kconfig.defconfig"
```

## stm32/zephyr/satelliteOBC/build/Kconfig/boards/Kconfig.nucleo_f303re
```kconfig
# Load board Kconfig descriptions.
osource "/gsFiles/Projects/stm32/zephyr/satelliteOBC/zephyr/boards/st/nucleo_f303re/Kconfig.nucleo_f303re"
```

## stm32/zephyr/satelliteOBC/build/Kconfig/boards/Kconfig.sysbuild
```kconfig
# Load Sysbuild board Kconfig descriptions.
osource "/gsFiles/Projects/stm32/zephyr/satelliteOBC/zephyr/boards/st/nucleo_f303re/Kconfig.sysbuild"
```

## stm32/zephyr/satelliteOBC/build/Kconfig/soc/Kconfig
```kconfig
# Load Zephyr SoC Kconfig descriptions.
osource "/gsFiles/Projects/stm32/zephyr/satelliteOBC/zephyr/soc/xlnx/zynqmp/Kconfig"
osource "/gsFiles/Projects/stm32/zephyr/satelliteOBC/zephyr/soc/xlnx/zynq7000/Kconfig"
osource "/gsFiles/Projects/stm32/zephyr/satelliteOBC/zephyr/soc/xlnx/versalnet/Kconfig"
osource "/gsFiles/Projects/stm32/zephyr/satelliteOBC/zephyr/soc/xlnx/versal2/Kconfig"
osource "/gsFiles/Projects/stm32/zephyr/satelliteOBC/zephyr/soc/xlnx/versal/Kconfig"
osource "/gsFiles/Projects/stm32/zephyr/satelliteOBC/zephyr/soc/xen/Kconfig"
osource "/gsFiles/Projects/stm32/zephyr/satelliteOBC/zephyr/soc/wch/ch32v/Kconfig"
osource "/gsFiles/Projects/stm32/zephyr/satelliteOBC/zephyr/soc/ti/simplelink/Kconfig"
osource "/gsFiles/Projects/stm32/zephyr/satelliteOBC/zephyr/soc/ti/mspm0/Kconfig"
osource "/gsFiles/Projects/stm32/zephyr/satelliteOBC/zephyr/soc/ti/lm3s6965/Kconfig"
osource "/gsFiles/Projects/stm32/zephyr/satelliteOBC/zephyr/soc/ti/k3/Kconfig"
osource "/gsFiles/Projects/stm32/zephyr/satelliteOBC/zephyr/soc/telink/tlsr/Kconfig"
osource "/gsFiles/Projects/stm32/zephyr/satelliteOBC/zephyr/soc/syna/sr100/Kconfig"
osource "/gsFiles/Projects/stm32/zephyr/satelliteOBC/zephyr/soc/starfive/jh71xx/Kconfig"
osource "/gsFiles/Projects/stm32/zephyr/satelliteOBC/zephyr/soc/st/stm32/Kconfig"
osource "/gsFiles/Projects/stm32/zephyr/satelliteOBC/zephyr/soc/snps/qemu_arc/Kconfig"
osource "/gsFiles/Projects/stm32/zephyr/satelliteOBC/zephyr/soc/snps/nsim/arc_v/Kconfig"
osource "/gsFiles/Projects/stm32/zephyr/satelliteOBC/zephyr/soc/snps/nsim/arc_classic/Kconfig"
osource "/gsFiles/Projects/stm32/zephyr/satelliteOBC/zephyr/soc/snps/hsdk4xd/Kconfig"
osource "/gsFiles/Projects/stm32/zephyr/satelliteOBC/zephyr/soc/snps/hsdk/Kconfig"
osource "/gsFiles/Projects/stm32/zephyr/satelliteOBC/zephyr/soc/snps/emsk/Kconfig"
osource "/gsFiles/Projects/stm32/zephyr/satelliteOBC/zephyr/soc/snps/emsdp/Kconfig"
osource "/gsFiles/Projects/stm32/zephyr/satelliteOBC/zephyr/soc/snps/arc_iot/Kconfig"
osource "/gsFiles/Projects/stm32/zephyr/satelliteOBC/zephyr/soc/silabs/Kconfig"
osource "/gsFiles/Projects/stm32/zephyr/satelliteOBC/zephyr/soc/sifli/sf32/Kconfig"
osource "/gsFiles/Projects/stm32/zephyr/satelliteOBC/zephyr/soc/sifive/sifive_freedom/Kconfig"
osource "/gsFiles/Projects/stm32/zephyr/satelliteOBC/zephyr/soc/sensry/Kconfig"
osource "/gsFiles/Projects/stm32/zephyr/satelliteOBC/zephyr/soc/rockchip/Kconfig"
osource "/gsFiles/Projects/stm32/zephyr/satelliteOBC/zephyr/soc/renode/riscv_virtual/Kconfig"
osource "/gsFiles/Projects/stm32/zephyr/satelliteOBC/zephyr/soc/renode/cortex_r8_virtual/Kconfig"
osource "/gsFiles/Projects/stm32/zephyr/satelliteOBC/zephyr/soc/renesas/smartbond/Kconfig"
osource "/gsFiles/Projects/stm32/zephyr/satelliteOBC/zephyr/soc/renesas/rz/Kconfig"
osource "/gsFiles/Projects/stm32/zephyr/satelliteOBC/zephyr/soc/renesas/rx/Kconfig"
osource "/gsFiles/Projects/stm32/zephyr/satelliteOBC/zephyr/soc/renesas/rcar/Kconfig"
osource "/gsFiles/Projects/stm32/zephyr/satelliteOBC/zephyr/soc/renesas/ra/Kconfig"
osource "/gsFiles/Projects/stm32/zephyr/satelliteOBC/zephyr/soc/realtek/fingerprint/Kconfig"
osource "/gsFiles/Projects/stm32/zephyr/satelliteOBC/zephyr/soc/realtek/ec/Kconfig"
osource "/gsFiles/Projects/stm32/zephyr/satelliteOBC/zephyr/soc/realtek/bee/Kconfig"
osource "/gsFiles/Projects/stm32/zephyr/satelliteOBC/zephyr/soc/realtek/ameba/Kconfig"
osource "/gsFiles/Projects/stm32/zephyr/satelliteOBC/zephyr/soc/raspberrypi/rpi_pico/Kconfig"
osource "/gsFiles/Projects/stm32/zephyr/satelliteOBC/zephyr/soc/quicklogic/eos_s3/Kconfig"
osource "/gsFiles/Projects/stm32/zephyr/satelliteOBC/zephyr/soc/qemu/virt_riscv/Kconfig"
osource "/gsFiles/Projects/stm32/zephyr/satelliteOBC/zephyr/soc/qemu/or1k/Kconfig"
osource "/gsFiles/Projects/stm32/zephyr/satelliteOBC/zephyr/soc/qemu/malta/Kconfig"
osource "/gsFiles/Projects/stm32/zephyr/satelliteOBC/zephyr/soc/openisa/rv32m1/Kconfig"
osource "/gsFiles/Projects/stm32/zephyr/satelliteOBC/zephyr/soc/openhwgroup/cva6/Kconfig"
osource "/gsFiles/Projects/stm32/zephyr/satelliteOBC/zephyr/soc/oct/osd32mp15x/Kconfig"
osource "/gsFiles/Projects/stm32/zephyr/satelliteOBC/zephyr/soc/nxp/s32/Kconfig"
osource "/gsFiles/Projects/stm32/zephyr/satelliteOBC/zephyr/soc/nxp/rw/Kconfig"
osource "/gsFiles/Projects/stm32/zephyr/satelliteOBC/zephyr/soc/nxp/mcx/Kconfig"
osource "/gsFiles/Projects/stm32/zephyr/satelliteOBC/zephyr/soc/nxp/lpc/Kconfig"
osource "/gsFiles/Projects/stm32/zephyr/satelliteOBC/zephyr/soc/nxp/layerscape/Kconfig"
osource "/gsFiles/Projects/stm32/zephyr/satelliteOBC/zephyr/soc/nxp/kinetis/Kconfig"
osource "/gsFiles/Projects/stm32/zephyr/satelliteOBC/zephyr/soc/nxp/imxrt/Kconfig"
osource "/gsFiles/Projects/stm32/zephyr/satelliteOBC/zephyr/soc/nxp/imx/Kconfig"
osource "/gsFiles/Projects/stm32/zephyr/satelliteOBC/zephyr/soc/nuvoton/numicro/Kconfig"
osource "/gsFiles/Projects/stm32/zephyr/satelliteOBC/zephyr/soc/nuvoton/numaker/Kconfig"
osource "/gsFiles/Projects/stm32/zephyr/satelliteOBC/zephyr/soc/nuvoton/npcx/Kconfig"
osource "/gsFiles/Projects/stm32/zephyr/satelliteOBC/zephyr/soc/nuvoton/npcm/Kconfig"
osource "/gsFiles/Projects/stm32/zephyr/satelliteOBC/zephyr/soc/nordic/Kconfig"
osource "/gsFiles/Projects/stm32/zephyr/satelliteOBC/zephyr/soc/neorv32/Kconfig"
osource "/gsFiles/Projects/stm32/zephyr/satelliteOBC/zephyr/soc/native/inf_clock/Kconfig"
osource "/gsFiles/Projects/stm32/zephyr/satelliteOBC/zephyr/soc/microchip/sam/sama7/Kconfig"
osource "/gsFiles/Projects/stm32/zephyr/satelliteOBC/zephyr/soc/microchip/sam/sam_d5x_e5x/Kconfig"
osource "/gsFiles/Projects/stm32/zephyr/satelliteOBC/zephyr/soc/microchip/pic64/Kconfig"
osource "/gsFiles/Projects/stm32/zephyr/satelliteOBC/zephyr/soc/microchip/pic32c/pic32cz_ca/Kconfig"
osource "/gsFiles/Projects/stm32/zephyr/satelliteOBC/zephyr/soc/microchip/pic32c/pic32cx_sg/Kconfig"
osource "/gsFiles/Projects/stm32/zephyr/satelliteOBC/zephyr/soc/microchip/pic32c/pic32cm_sg_gc/Kconfig"
osource "/gsFiles/Projects/stm32/zephyr/satelliteOBC/zephyr/soc/microchip/pic32c/pic32cm_pl/Kconfig"
osource "/gsFiles/Projects/stm32/zephyr/satelliteOBC/zephyr/soc/microchip/pic32c/pic32cm_jh/Kconfig"
osource "/gsFiles/Projects/stm32/zephyr/satelliteOBC/zephyr/soc/microchip/pic32c/pic32ck_sg_gc/Kconfig"
osource "/gsFiles/Projects/stm32/zephyr/satelliteOBC/zephyr/soc/microchip/miv/Kconfig"
osource "/gsFiles/Projects/stm32/zephyr/satelliteOBC/zephyr/soc/microchip/mec/Kconfig"
osource "/gsFiles/Projects/stm32/zephyr/satelliteOBC/zephyr/soc/mediatek/mt8xxx/Kconfig"
osource "/gsFiles/Projects/stm32/zephyr/satelliteOBC/zephyr/soc/lowrisc/opentitan/Kconfig"
osource "/gsFiles/Projects/stm32/zephyr/satelliteOBC/zephyr/soc/litex/Kconfig"
osource "/gsFiles/Projects/stm32/zephyr/satelliteOBC/zephyr/soc/ite/ec/Kconfig"
osource "/gsFiles/Projects/stm32/zephyr/satelliteOBC/zephyr/soc/intel/wildcat_lake/Kconfig"
osource "/gsFiles/Projects/stm32/zephyr/satelliteOBC/zephyr/soc/intel/raptor_lake/Kconfig"
osource "/gsFiles/Projects/stm32/zephyr/satelliteOBC/zephyr/soc/intel/panther_lake/Kconfig"
osource "/gsFiles/Projects/stm32/zephyr/satelliteOBC/zephyr/soc/intel/lakemont/Kconfig"
osource "/gsFiles/Projects/stm32/zephyr/satelliteOBC/zephyr/soc/intel/intel_socfpga_std/Kconfig"
osource "/gsFiles/Projects/stm32/zephyr/satelliteOBC/zephyr/soc/intel/intel_socfpga/Kconfig"
osource "/gsFiles/Projects/stm32/zephyr/satelliteOBC/zephyr/soc/intel/intel_niosv/Kconfig"
osource "/gsFiles/Projects/stm32/zephyr/satelliteOBC/zephyr/soc/intel/intel_ish/Kconfig"
osource "/gsFiles/Projects/stm32/zephyr/satelliteOBC/zephyr/soc/intel/intel_adsp/Kconfig"
osource "/gsFiles/Projects/stm32/zephyr/satelliteOBC/zephyr/soc/intel/elkhart_lake/Kconfig"
osource "/gsFiles/Projects/stm32/zephyr/satelliteOBC/zephyr/soc/intel/atom/Kconfig"
osource "/gsFiles/Projects/stm32/zephyr/satelliteOBC/zephyr/soc/intel/apollo_lake/Kconfig"
osource "/gsFiles/Projects/stm32/zephyr/satelliteOBC/zephyr/soc/intel/alder_lake/Kconfig"
osource "/gsFiles/Projects/stm32/zephyr/satelliteOBC/zephyr/soc/infineon/psoc4/Kconfig"
osource "/gsFiles/Projects/stm32/zephyr/satelliteOBC/zephyr/soc/infineon/edge/Kconfig"
osource "/gsFiles/Projects/stm32/zephyr/satelliteOBC/zephyr/soc/infineon/cat3/Kconfig"
osource "/gsFiles/Projects/stm32/zephyr/satelliteOBC/zephyr/soc/infineon/cat1c/Kconfig"
osource "/gsFiles/Projects/stm32/zephyr/satelliteOBC/zephyr/soc/infineon/cat1b/Kconfig"
osource "/gsFiles/Projects/stm32/zephyr/satelliteOBC/zephyr/soc/infineon/cat1a/Kconfig"
osource "/gsFiles/Projects/stm32/zephyr/satelliteOBC/zephyr/soc/gd/gd32/Kconfig"
osource "/gsFiles/Projects/stm32/zephyr/satelliteOBC/zephyr/soc/gaisler/leon3/Kconfig"
osource "/gsFiles/Projects/stm32/zephyr/satelliteOBC/zephyr/soc/gaisler/gr716a/Kconfig"
osource "/gsFiles/Projects/stm32/zephyr/satelliteOBC/zephyr/soc/focaltech/Kconfig"
osource "/gsFiles/Projects/stm32/zephyr/satelliteOBC/zephyr/soc/espressif/Kconfig"
osource "/gsFiles/Projects/stm32/zephyr/satelliteOBC/zephyr/soc/ene/kb1200/Kconfig"
osource "/gsFiles/Projects/stm32/zephyr/satelliteOBC/zephyr/soc/ene/kb106x/Kconfig"
osource "/gsFiles/Projects/stm32/zephyr/satelliteOBC/zephyr/soc/elan/em32f967/Kconfig"
osource "/gsFiles/Projects/stm32/zephyr/satelliteOBC/zephyr/soc/egis/Kconfig"
osource "/gsFiles/Projects/stm32/zephyr/satelliteOBC/zephyr/soc/efinix/sapphire/Kconfig"
osource "/gsFiles/Projects/stm32/zephyr/satelliteOBC/zephyr/soc/cdns/xtensa_sample_controller/Kconfig"
osource "/gsFiles/Projects/stm32/zephyr/satelliteOBC/zephyr/soc/cdns/swerv/Kconfig"
osource "/gsFiles/Projects/stm32/zephyr/satelliteOBC/zephyr/soc/cdns/sample_controller32/Kconfig"
osource "/gsFiles/Projects/stm32/zephyr/satelliteOBC/zephyr/soc/cdns/dc233c/Kconfig"
osource "/gsFiles/Projects/stm32/zephyr/satelliteOBC/zephyr/soc/brcm/bcmvk/Kconfig"
osource "/gsFiles/Projects/stm32/zephyr/satelliteOBC/zephyr/soc/brcm/bcm2712/Kconfig"
osource "/gsFiles/Projects/stm32/zephyr/satelliteOBC/zephyr/soc/brcm/bcm2711/Kconfig"
osource "/gsFiles/Projects/stm32/zephyr/satelliteOBC/zephyr/soc/blackberry/qnxhv_vm/Kconfig"
osource "/gsFiles/Projects/stm32/zephyr/satelliteOBC/zephyr/soc/bflb/Kconfig"
osource "/gsFiles/Projects/stm32/zephyr/satelliteOBC/zephyr/soc/atmel/sam0/Kconfig"
osource "/gsFiles/Projects/stm32/zephyr/satelliteOBC/zephyr/soc/atmel/sam/Kconfig"
osource "/gsFiles/Projects/stm32/zephyr/satelliteOBC/zephyr/soc/aspeed/Kconfig"
osource "/gsFiles/Projects/stm32/zephyr/satelliteOBC/zephyr/soc/arm/Kconfig"
osource "/gsFiles/Projects/stm32/zephyr/satelliteOBC/zephyr/soc/arm/beetle/Kconfig"
osource "/gsFiles/Projects/stm32/zephyr/satelliteOBC/zephyr/soc/antmicro/myra/Kconfig"
osource "/gsFiles/Projects/stm32/zephyr/satelliteOBC/zephyr/soc/andestech/Kconfig"
osource "/gsFiles/Projects/stm32/zephyr/satelliteOBC/zephyr/soc/amd/acp_7_0/Kconfig"
osource "/gsFiles/Projects/stm32/zephyr/satelliteOBC/zephyr/soc/amd/acp_6_0/Kconfig"
osource "/gsFiles/Projects/stm32/zephyr/satelliteOBC/zephyr/soc/ambiq/Kconfig"
osource "/gsFiles/Projects/stm32/zephyr/satelliteOBC/zephyr/soc/allwinner/sun8i_h3/Kconfig"
osource "/gsFiles/Projects/stm32/zephyr/satelliteOBC/zephyr/soc/allwinner/sun50i_h618/Kconfig"
osource "/gsFiles/Projects/stm32/zephyr/satelliteOBC/zephyr/soc/alif/ensemble/Kconfig"
osource "/gsFiles/Projects/stm32/zephyr/satelliteOBC/zephyr/soc/alif/balletto/Kconfig"
osource "/gsFiles/Projects/stm32/zephyr/satelliteOBC/zephyr/soc/aesc/Kconfig"
osource "/gsFiles/Projects/stm32/zephyr/satelliteOBC/zephyr/soc/adi/max32/Kconfig"
```
