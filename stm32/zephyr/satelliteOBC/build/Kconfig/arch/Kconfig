## stm32/zephyr/satelliteOBC/build/Kconfig/soc/Kconfig.defconfig
```kconfig
# Load Zephyr SoC defconfig descriptions.
osource "/gsFiles/Projects/stm32/zephyr/satelliteOBC/zephyr/soc/xlnx/zynqmp/Kconfig.defconfig"
osource "/gsFiles/Projects/stm32/zephyr/satelliteOBC/zephyr/soc/xlnx/zynq7000/Kconfig.defconfig"
osource "/gsFiles/Projects/stm32/zephyr/satelliteOBC/zephyr/soc/xlnx/versalnet/Kconfig.defconfig"
osource "/gsFiles/Projects/stm32/zephyr/satelliteOBC/zephyr/soc/xlnx/versal2/Kconfig.defconfig"
osource "/gsFiles/Projects/stm32/zephyr/satelliteOBC/zephyr/soc/xlnx/versal/Kconfig.defconfig"
osource "/gsFiles/Projects/stm32/zephyr/satelliteOBC/zephyr/soc/xen/Kconfig.defconfig"
osource "/gsFiles/Projects/stm32/zephyr/satelliteOBC/zephyr/soc/wch/ch32v/Kconfig.defconfig"
osource "/gsFiles/Projects/stm32/zephyr/satelliteOBC/zephyr/soc/ti/simplelink/Kconfig.defconfig"
osource "/gsFiles/Projects/stm32/zephyr/satelliteOBC/zephyr/soc/ti/mspm0/Kconfig.defconfig"
osource "/gsFiles/Projects/stm32/zephyr/satelliteOBC/zephyr/soc/ti/lm3s6965/Kconfig.defconfig"
osource "/gsFiles/Projects/stm32/zephyr/satelliteOBC/zephyr/soc/ti/k3/Kconfig.defconfig"
osource "/gsFiles/Projects/stm32/zephyr/satelliteOBC/zephyr/soc/telink/tlsr/Kconfig.defconfig"
osource "/gsFiles/Projects/stm32/zephyr/satelliteOBC/zephyr/soc/syna/sr100/Kconfig.defconfig"
osource "/gsFiles/Projects/stm32/zephyr/satelliteOBC/zephyr/soc/starfive/jh71xx/Kconfig.defconfig"
osource "/gsFiles/Projects/stm32/zephyr/satelliteOBC/zephyr/soc/st/stm32/Kconfig.defconfig"
osource "/gsFiles/Projects/stm32/zephyr/satelliteOBC/zephyr/soc/snps/qemu_arc/Kconfig.defconfig"
osource "/gsFiles/Projects/stm32/zephyr/satelliteOBC/zephyr/soc/snps/nsim/arc_v/Kconfig.defconfig"
osource "/gsFiles/Projects/stm32/zephyr/satelliteOBC/zephyr/soc/snps/nsim/arc_classic/Kconfig.defconfig"
osource "/gsFiles/Projects/stm32/zephyr/satelliteOBC/zephyr/soc/snps/hsdk4xd/Kconfig.defconfig"
osource "/gsFiles/Projects/stm32/zephyr/satelliteOBC/zephyr/soc/snps/hsdk/Kconfig.defconfig"
osource "/gsFiles/Projects/stm32/zephyr/satelliteOBC/zephyr/soc/snps/emsk/Kconfig.defconfig"
osource "/gsFiles/Projects/stm32/zephyr/satelliteOBC/zephyr/soc/snps/emsdp/Kconfig.defconfig"
osource "/gsFiles/Projects/stm32/zephyr/satelliteOBC/zephyr/soc/snps/arc_iot/Kconfig.defconfig"
osource "/gsFiles/Projects/stm32/zephyr/satelliteOBC/zephyr/soc/silabs/Kconfig.defconfig"
osource "/gsFiles/Projects/stm32/zephyr/satelliteOBC/zephyr/soc/sifli/sf32/Kconfig.defconfig"
osource "/gsFiles/Projects/stm32/zephyr/satelliteOBC/zephyr/soc/sifive/sifive_freedom/Kconfig.defconfig"
osource "/gsFiles/Projects/stm32/zephyr/satelliteOBC/zephyr/soc/sensry/Kconfig.defconfig"
osource "/gsFiles/Projects/stm32/zephyr/satelliteOBC/zephyr/soc/rockchip/Kconfig.defconfig"
osource "/gsFiles/Projects/stm32/zephyr/satelliteOBC/zephyr/soc/renode/riscv_virtual/Kconfig.defconfig"
osource "/gsFiles/Projects/stm32/zephyr/satelliteOBC/zephyr/soc/renode/cortex_r8_virtual/Kconfig.defconfig"
osource "/gsFiles/Projects/stm32/zephyr/satelliteOBC/zephyr/soc/renesas/smartbond/Kconfig.defconfig"
osource "/gsFiles/Projects/stm32/zephyr/satelliteOBC/zephyr/soc/renesas/rz/Kconfig.defconfig"
osource "/gsFiles/Projects/stm32/zephyr/satelliteOBC/zephyr/soc/renesas/rx/Kconfig.defconfig"
osource "/gsFiles/Projects/stm32/zephyr/satelliteOBC/zephyr/soc/renesas/rcar/Kconfig.defconfig"
osource "/gsFiles/Projects/stm32/zephyr/satelliteOBC/zephyr/soc/renesas/ra/Kconfig.defconfig"
osource "/gsFiles/Projects/stm32/zephyr/satelliteOBC/zephyr/soc/realtek/fingerprint/Kconfig.defconfig"
osource "/gsFiles/Projects/stm32/zephyr/satelliteOBC/zephyr/soc/realtek/ec/Kconfig.defconfig"
osource "/gsFiles/Projects/stm32/zephyr/satelliteOBC/zephyr/soc/realtek/bee/Kconfig.defconfig"
osource "/gsFiles/Projects/stm32/zephyr/satelliteOBC/zephyr/soc/realtek/ameba/Kconfig.defconfig"
osource "/gsFiles/Projects/stm32/zephyr/satelliteOBC/zephyr/soc/raspberrypi/rpi_pico/Kconfig.defconfig"
osource "/gsFiles/Projects/stm32/zephyr/satelliteOBC/zephyr/soc/quicklogic/eos_s3/Kconfig.defconfig"
osource "/gsFiles/Projects/stm32/zephyr/satelliteOBC/zephyr/soc/qemu/virt_riscv/Kconfig.defconfig"
osource "/gsFiles/Projects/stm32/zephyr/satelliteOBC/zephyr/soc/qemu/or1k/Kconfig.defconfig"
osource "/gsFiles/Projects/stm32/zephyr/satelliteOBC/zephyr/soc/qemu/malta/Kconfig.defconfig"
osource "/gsFiles/Projects/stm32/zephyr/satelliteOBC/zephyr/soc/openisa/rv32m1/Kconfig.defconfig"
osource "/gsFiles/Projects/stm32/zephyr/satelliteOBC/zephyr/soc/openhwgroup/cva6/Kconfig.defconfig"
osource "/gsFiles/Projects/stm32/zephyr/satelliteOBC/zephyr/soc/oct/osd32mp15x/Kconfig.defconfig"
osource "/gsFiles/Projects/stm32/zephyr/satelliteOBC/zephyr/soc/nxp/s32/Kconfig.defconfig"
osource "/gsFiles/Projects/stm32/zephyr/satelliteOBC/zephyr/soc/nxp/rw/Kconfig.defconfig"
osource "/gsFiles/Projects/stm32/zephyr/satelliteOBC/zephyr/soc/nxp/mcx/Kconfig.defconfig"
osource "/gsFiles/Projects/stm32/zephyr/satelliteOBC/zephyr/soc/nxp/lpc/Kconfig.defconfig"
osource "/gsFiles/Projects/stm32/zephyr/satelliteOBC/zephyr/soc/nxp/layerscape/Kconfig.defconfig"
osource "/gsFiles/Projects/stm32/zephyr/satelliteOBC/zephyr/soc/nxp/kinetis/Kconfig.defconfig"
osource "/gsFiles/Projects/stm32/zephyr/satelliteOBC/zephyr/soc/nxp/imxrt/Kconfig.defconfig"
osource "/gsFiles/Projects/stm32/zephyr/satelliteOBC/zephyr/soc/nxp/imx/Kconfig.defconfig"
osource "/gsFiles/Projects/stm32/zephyr/satelliteOBC/zephyr/soc/nuvoton/numicro/Kconfig.defconfig"
osource "/gsFiles/Projects/stm32/zephyr/satelliteOBC/zephyr/soc/nuvoton/numaker/Kconfig.defconfig"
osource "/gsFiles/Projects/stm32/zephyr/satelliteOBC/zephyr/soc/nuvoton/npcx/Kconfig.defconfig"
osource "/gsFiles/Projects/stm32/zephyr/satelliteOBC/zephyr/soc/nuvoton/npcm/Kconfig.defconfig"
osource "/gsFiles/Projects/stm32/zephyr/satelliteOBC/zephyr/soc/nordic/Kconfig.defconfig"
osource "/gsFiles/Projects/stm32/zephyr/satelliteOBC/zephyr/soc/neorv32/Kconfig.defconfig"
osource "/gsFiles/Projects/stm32/zephyr/satelliteOBC/zephyr/soc/native/inf_clock/Kconfig.defconfig"
osource "/gsFiles/Projects/stm32/zephyr/satelliteOBC/zephyr/soc/microchip/sam/sama7/Kconfig.defconfig"
osource "/gsFiles/Projects/stm32/zephyr/satelliteOBC/zephyr/soc/microchip/sam/sam_d5x_e5x/Kconfig.defconfig"
osource "/gsFiles/Projects/stm32/zephyr/satelliteOBC/zephyr/soc/microchip/pic64/Kconfig.defconfig"
osource "/gsFiles/Projects/stm32/zephyr/satelliteOBC/zephyr/soc/microchip/pic32c/pic32cz_ca/Kconfig.defconfig"
osource "/gsFiles/Projects/stm32/zephyr/satelliteOBC/zephyr/soc/microchip/pic32c/pic32cx_sg/Kconfig.defconfig"
osource "/gsFiles/Projects/stm32/zephyr/satelliteOBC/zephyr/soc/microchip/pic32c/pic32cm_sg_gc/Kconfig.defconfig"
osource "/gsFiles/Projects/stm32/zephyr/satelliteOBC/zephyr/soc/microchip/pic32c/pic32cm_pl/Kconfig.defconfig"
osource "/gsFiles/Projects/stm32/zephyr/satelliteOBC/zephyr/soc/microchip/pic32c/pic32cm_jh/Kconfig.defconfig"
osource "/gsFiles/Projects/stm32/zephyr/satelliteOBC/zephyr/soc/microchip/pic32c/pic32ck_sg_gc/Kconfig.defconfig"
osource "/gsFiles/Projects/stm32/zephyr/satelliteOBC/zephyr/soc/microchip/miv/Kconfig.defconfig"
osource "/gsFiles/Projects/stm32/zephyr/satelliteOBC/zephyr/soc/microchip/mec/Kconfig.defconfig"
osource "/gsFiles/Projects/stm32/zephyr/satelliteOBC/zephyr/soc/mediatek/mt8xxx/Kconfig.defconfig"
osource "/gsFiles/Projects/stm32/zephyr/satelliteOBC/zephyr/soc/lowrisc/opentitan/Kconfig.defconfig"
osource "/gsFiles/Projects/stm32/zephyr/satelliteOBC/zephyr/soc/litex/Kconfig.defconfig"
osource "/gsFiles/Projects/stm32/zephyr/satelliteOBC/zephyr/soc/ite/ec/Kconfig.defconfig"
osource "/gsFiles/Projects/stm32/zephyr/satelliteOBC/zephyr/soc/intel/wildcat_lake/Kconfig.defconfig"
osource "/gsFiles/Projects/stm32/zephyr/satelliteOBC/zephyr/soc/intel/raptor_lake/Kconfig.defconfig"
osource "/gsFiles/Projects/stm32/zephyr/satelliteOBC/zephyr/soc/intel/panther_lake/Kconfig.defconfig"
osource "/gsFiles/Projects/stm32/zephyr/satelliteOBC/zephyr/soc/intel/lakemont/Kconfig.defconfig"
osource "/gsFiles/Projects/stm32/zephyr/satelliteOBC/zephyr/soc/intel/intel_socfpga_std/Kconfig.defconfig"
osource "/gsFiles/Projects/stm32/zephyr/satelliteOBC/zephyr/soc/intel/intel_socfpga/Kconfig.defconfig"
osource "/gsFiles/Projects/stm32/zephyr/satelliteOBC/zephyr/soc/intel/intel_niosv/Kconfig.defconfig"
osource "/gsFiles/Projects/stm32/zephyr/satelliteOBC/zephyr/soc/intel/intel_ish/Kconfig.defconfig"
osource "/gsFiles/Projects/stm32/zephyr/satelliteOBC/zephyr/soc/intel/intel_adsp/Kconfig.defconfig"
osource "/gsFiles/Projects/stm32/zephyr/satelliteOBC/zephyr/soc/intel/elkhart_lake/Kconfig.defconfig"
osource "/gsFiles/Projects/stm32/zephyr/satelliteOBC/zephyr/soc/intel/atom/Kconfig.defconfig"
osource "/gsFiles/Projects/stm32/zephyr/satelliteOBC/zephyr/soc/intel/apollo_lake/Kconfig.defconfig"
osource "/gsFiles/Projects/stm32/zephyr/satelliteOBC/zephyr/soc/intel/alder_lake/Kconfig.defconfig"
osource "/gsFiles/Projects/stm32/zephyr/satelliteOBC/zephyr/soc/infineon/psoc4/Kconfig.defconfig"
osource "/gsFiles/Projects/stm32/zephyr/satelliteOBC/zephyr/soc/infineon/edge/Kconfig.defconfig"
osource "/gsFiles/Projects/stm32/zephyr/satelliteOBC/zephyr/soc/infineon/cat3/Kconfig.defconfig"
osource "/gsFiles/Projects/stm32/zephyr/satelliteOBC/zephyr/soc/infineon/cat1c/Kconfig.defconfig"
osource "/gsFiles/Projects/stm32/zephyr/satelliteOBC/zephyr/soc/infineon/cat1b/Kconfig.defconfig"
osource "/gsFiles/Projects/stm32/zephyr/satelliteOBC/zephyr/soc/infineon/cat1a/Kconfig.defconfig"
osource "/gsFiles/Projects/stm32/zephyr/satelliteOBC/zephyr/soc/gd/gd32/Kconfig.defconfig"
osource "/gsFiles/Projects/stm32/zephyr/satelliteOBC/zephyr/soc/gaisler/leon3/Kconfig.defconfig"
osource "/gsFiles/Projects/stm32/zephyr/satelliteOBC/zephyr/soc/gaisler/gr716a/Kconfig.defconfig"
osource "/gsFiles/Projects/stm32/zephyr/satelliteOBC/zephyr/soc/focaltech/Kconfig.defconfig"
osource "/gsFiles/Projects/stm32/zephyr/satelliteOBC/zephyr/soc/espressif/Kconfig.defconfig"
osource "/gsFiles/Projects/stm32/zephyr/satelliteOBC/zephyr/soc/ene/kb1200/Kconfig.defconfig"
osource "/gsFiles/Projects/stm32/zephyr/satelliteOBC/zephyr/soc/ene/kb106x/Kconfig.defconfig"
osource "/gsFiles/Projects/stm32/zephyr/satelliteOBC/zephyr/soc/elan/em32f967/Kconfig.defconfig"
osource "/gsFiles/Projects/stm32/zephyr/satelliteOBC/zephyr/soc/egis/Kconfig.defconfig"
osource "/gsFiles/Projects/stm32/zephyr/satelliteOBC/zephyr/soc/efinix/sapphire/Kconfig.defconfig"
osource "/gsFiles/Projects/stm32/zephyr/satelliteOBC/zephyr/soc/cdns/xtensa_sample_controller/Kconfig.defconfig"
osource "/gsFiles/Projects/stm32/zephyr/satelliteOBC/zephyr/soc/cdns/swerv/Kconfig.defconfig"
osource "/gsFiles/Projects/stm32/zephyr/satelliteOBC/zephyr/soc/cdns/sample_controller32/Kconfig.defconfig"
osource "/gsFiles/Projects/stm32/zephyr/satelliteOBC/zephyr/soc/cdns/dc233c/Kconfig.defconfig"
osource "/gsFiles/Projects/stm32/zephyr/satelliteOBC/zephyr/soc/brcm/bcmvk/Kconfig.defconfig"
osource "/gsFiles/Projects/stm32/zephyr/satelliteOBC/zephyr/soc/brcm/bcm2712/Kconfig.defconfig"
osource "/gsFiles/Projects/stm32/zephyr/satelliteOBC/zephyr/soc/brcm/bcm2711/Kconfig.defconfig"
osource "/gsFiles/Projects/stm32/zephyr/satelliteOBC/zephyr/soc/blackberry/qnxhv_vm/Kconfig.defconfig"
osource "/gsFiles/Projects/stm32/zephyr/satelliteOBC/zephyr/soc/bflb/Kconfig.defconfig"
osource "/gsFiles/Projects/stm32/zephyr/satelliteOBC/zephyr/soc/atmel/sam0/Kconfig.defconfig"
osource "/gsFiles/Projects/stm32/zephyr/satelliteOBC/zephyr/soc/atmel/sam/Kconfig.defconfig"
osource "/gsFiles/Projects/stm32/zephyr/satelliteOBC/zephyr/soc/aspeed/Kconfig.defconfig"
osource "/gsFiles/Projects/stm32/zephyr/satelliteOBC/zephyr/soc/arm/Kconfig.defconfig"
osource "/gsFiles/Projects/stm32/zephyr/satelliteOBC/zephyr/soc/arm/beetle/Kconfig.defconfig"
osource "/gsFiles/Projects/stm32/zephyr/satelliteOBC/zephyr/soc/antmicro/myra/Kconfig.defconfig"
osource "/gsFiles/Projects/stm32/zephyr/satelliteOBC/zephyr/soc/andestech/Kconfig.defconfig"
osource "/gsFiles/Projects/stm32/zephyr/satelliteOBC/zephyr/soc/amd/acp_7_0/Kconfig.defconfig"
osource "/gsFiles/Projects/stm32/zephyr/satelliteOBC/zephyr/soc/amd/acp_6_0/Kconfig.defconfig"
osource "/gsFiles/Projects/stm32/zephyr/satelliteOBC/zephyr/soc/ambiq/Kconfig.defconfig"
osource "/gsFiles/Projects/stm32/zephyr/satelliteOBC/zephyr/soc/allwinner/sun8i_h3/Kconfig.defconfig"
osource "/gsFiles/Projects/stm32/zephyr/satelliteOBC/zephyr/soc/allwinner/sun50i_h618/Kconfig.defconfig"
osource "/gsFiles/Projects/stm32/zephyr/satelliteOBC/zephyr/soc/alif/ensemble/Kconfig.defconfig"
osource "/gsFiles/Projects/stm32/zephyr/satelliteOBC/zephyr/soc/alif/balletto/Kconfig.defconfig"
osource "/gsFiles/Projects/stm32/zephyr/satelliteOBC/zephyr/soc/aesc/Kconfig.defconfig"
osource "/gsFiles/Projects/stm32/zephyr/satelliteOBC/zephyr/soc/adi/max32/Kconfig.defconfig"
```
